## Config.in
```kconfig
source "$BR2_EXTERNAL_PHYTEC_PATH/package/Config.in"
source "$BR2_EXTERNAL_PHYTEC_PATH/package/linux-firmware/Config.in"
```

## configs/phytec_imx6ull_segin_defconfig
```kconfig
BR2_arm=y
BR2_cortex_a7=y
BR2_ARM_FPU_NEON_VFPV4=y
BR2_TOOLCHAIN_BUILDROOT_GLIBC=y
BR2_PACKAGE_HOST_LINUX_HEADERS_CUSTOM_5_15=y
BR2_TOOLCHAIN_BUILDROOT_CXX=y
BR2_PACKAGE_HOST_GDB=y
BR2_TOOLCHAIN_GLIBC_GCONV_LIBS_COPY=y
BR2_TARGET_GENERIC_HOSTNAME="alc3"
BR2_TARGET_GENERIC_ISSUE="Welcome to Alc3"
BR2_TARGET_GENERIC_ROOT_PASSWD="NoPaSsWoRd"
BR2_TARGET_GENERIC_GETTY_PORT="ttymxc0"
BR2_ROOTFS_POST_IMAGE_SCRIPT="board/freescale/common/imx/post-image.sh"
BR2_LINUX_KERNEL=y
BR2_LINUX_KERNEL_CUSTOM_GIT=y
BR2_LINUX_KERNEL_CUSTOM_REPO_URL="git://git.phytec.de/linux-mainline"
BR2_LINUX_KERNEL_CUSTOM_REPO_VERSION="v5.15.63-phy1"
BR2_LINUX_KERNEL_USE_CUSTOM_CONFIG=y
BR2_LINUX_KERNEL_CUSTOM_CONFIG_FILE="$(BR2_EXTERNAL_PHYTEC_PATH)/board/phytec/imx6ull/linux-mainline_defconfig"
BR2_LINUX_KERNEL_DTS_SUPPORT=y
BR2_LINUX_KERNEL_DTB_IS_SELF_BUILT=y
BR2_LINUX_KERNEL_INTREE_DTS_NAME="imx6ul-phytec-segin-ff-rdk-emmc"
BR2_LINUX_KERNEL_DTB_OVERLAY_SUPPORT=y
BR2_LINUX_KERNEL_INSTALL_TARGET=y
BR2_LINUX_KERNEL_NEEDS_HOST_OPENSSL=y
BR2_PACKAGE_LINUX_FIRMWARE=y
BR2_TARGET_ROOTFS_EXT2=y
BR2_TARGET_ROOTFS_EXT2_4=y
BR2_TARGET_ROOTFS_UBIFS=y
BR2_TARGET_ROOTFS_UBIFS_LEBSIZE=0x1f000
BR2_TARGET_ROOTFS_UBIFS_MAXLEBCNT=7943
BR2_TARGET_BAREBOX=y
BR2_TARGET_BAREBOX_CUSTOM_GIT=y
BR2_TARGET_BAREBOX_CUSTOM_GIT_REPO_URL="git://git.phytec.de/barebox"
BR2_TARGET_BAREBOX_CUSTOM_GIT_VERSION="7fe12e65d770f7e657e683849681f339a996418b"
BR2_TARGET_BAREBOX_BOARD_DEFCONFIG="imx_v7"
BR2_TARGET_BAREBOX_IMAGE_FILE="images/barebox-phytec-phycore-imx6ull-emmc-512mb.img"
BR2_TARGET_BAREBOX_BAREBOXENV=y
BR2_TARGET_BAREBOX_CUSTOM_ENV=y
BR2_TARGET_BAREBOX_CUSTOM_ENV_PATH="barebox_env.img"
BR2_TARGET_UBOOT=y
BR2_TARGET_UBOOT_BUILD_SYSTEM_KCONFIG=y
BR2_TARGET_UBOOT_CUSTOM_GIT=y
BR2_TARGET_UBOOT_CUSTOM_REPO_URL="https://source.codeaurora.org/external/imx/uboot-imx.git"
BR2_TARGET_UBOOT_CUSTOM_REPO_VERSION="lf-5.10.y-1.0.0"
BR2_TARGET_UBOOT_BOARD_DEFCONFIG="mx6ull_14x14_evk"
BR2_TARGET_UBOOT_NEEDS_DTC=y
# BR2_TARGET_UBOOT_FORMAT_BIN is not set
BR2_TARGET_UBOOT_FORMAT_IMX=y
BR2_PACKAGE_HOST_DFU_UTIL=y
BR2_PACKAGE_HOST_DOSFSTOOLS=y
BR2_PACKAGE_HOST_IMX_MKIMAGE=y
BR2_PACKAGE_HOST_IMX_USB_LOADER=y
BR2_PACKAGE_HOST_MTOOLS=y
BR2_PACKAGE_BOARDNAME="segin"
BR2_PACKAGE_LINUX_FIRMWARE_IMX=y
```

## configs/phytec_imx8mp_pollux_defconfig
```kconfig
BR2_aarch64=y
BR2_TOOLCHAIN_BUILDROOT_GLIBC=y
BR2_PACKAGE_HOST_LINUX_HEADERS_CUSTOM_5_15=y
BR2_TOOLCHAIN_BUILDROOT_CXX=y
BR2_PACKAGE_HOST_GDB=y
BR2_TOOLCHAIN_GLIBC_GCONV_LIBS_COPY=y
BR2_TARGET_GENERIC_HOSTNAME="alc3"
BR2_TARGET_GENERIC_ISSUE="Welcome to Alc3"
BR2_TARGET_GENERIC_ROOT_PASSWD="NoPaSsWoRd"
BR2_TARGET_GENERIC_GETTY_PORT="ttymxc0"
BR2_ROOTFS_POST_IMAGE_SCRIPT="board/freescale/common/imx/post-image.sh"
BR2_LINUX_KERNEL=y
BR2_LINUX_KERNEL_CUSTOM_GIT=y
BR2_LINUX_KERNEL_CUSTOM_REPO_URL="git://source.codeaurora.org/external/imx/linux-imx.git"
BR2_LINUX_KERNEL_CUSTOM_REPO_VERSION="lf-5.15.y"
BR2_LINUX_KERNEL_DEFCONFIG="imx_v8"
BR2_LINUX_KERNEL_DTS_SUPPORT=y
BR2_LINUX_KERNEL_DTB_IS_SELF_BUILT=y
BR2_LINUX_KERNEL_INTREE_DTS_NAME="imx8mp-phyboard-pollux-rdk"
BR2_LINUX_KERNEL_DTB_OVERLAY_SUPPORT=y
BR2_LINUX_KERNEL_INSTALL_TARGET=y
BR2_LINUX_KERNEL_NEEDS_HOST_OPENSSL=y
BR2_PACKAGE_MESA3D=y
BR2_PACKAGE_MESA3D_LLVM=y
BR2_PACKAGE_MESA3D_GALLIUM_DRIVER_ETNAVIV=y
BR2_PACKAGE_MESA3D_GALLIUM_DRIVER_SWRAST=y
BR2_PACKAGE_LINUX_FIRMWARE=y
BR2_PACKAGE_FREESCALE_IMX=y
BR2_PACKAGE_FREESCALE_IMX_PLATFORM_IMX8MP=y
BR2_PACKAGE_IMX_CODEC=y
BR2_PACKAGE_IMX_PARSER=y
BR2_PACKAGE_IMX_UUC=y
BR2_PACKAGE_IMX_VPUWRAP=y
BR2_PACKAGE_FIRMWARE_IMX=y
BR2_PACKAGE_IMX_VPU_HANTRO_VC=y
BR2_PACKAGE_IMX_GPU_G2D=y
BR2_PACKAGE_IMX_GPU_G2D_EXAMPLES=y
BR2_PACKAGE_IMX_GPU_VIV_EXAMPLES=y
BR2_PACKAGE_IMX_GPU_VIV_GMEM_INFO=y
BR2_PACKAGE_KERNEL_MODULE_IMX_GPU_VIV=y
BR2_PACKAGE_UBOOT_TOOLS=y
BR2_PACKAGE_LIBDRM_NOUVEAU=y
BR2_PACKAGE_OPENCV4=y
BR2_PACKAGE_OPENCV4_LIB_VIDEOIO=y
BR2_PACKAGE_OPENCV4_WITH_JPEG=y
BR2_PACKAGE_OPENCV4_WITH_PNG=y
BR2_PACKAGE_OPENJPEG=y
BR2_PACKAGE_JANSSON=y
BR2_TARGET_ROOTFS_EXT2=y
BR2_TARGET_ROOTFS_EXT2_4=y
BR2_TARGET_ROOTFS_EXT2_SIZE="512M"
BR2_TARGET_ROOTFS_UBIFS=y
BR2_TARGET_ROOTFS_UBIFS_LEBSIZE=0x1f000
BR2_TARGET_ROOTFS_UBIFS_MAXLEBCNT=7943
BR2_PACKAGE_HOST_DTC=y
BR2_PACKAGE_HOST_GENIMAGE=y
BR2_PACKAGE_HOST_IMX_MKIMAGE=y
BR2_PACKAGE_HOST_IMX_USB_LOADER=y
BR2_PACKAGE_HOST_MTOOLS=y
```

## package/linux-firmware/Config.in
```kconfig
if BR2_PACKAGE_LINUX_FIRMWARE

config BR2_PACKAGE_LINUX_FIRMWARE_IMX
        bool "imx sdma firmware"
        help
          Firmware files for i.mx6 and i.mx7 sDMA chipset

endif
```
